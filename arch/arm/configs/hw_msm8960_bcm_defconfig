## arch/arm/configs/hw_msm8960_bcm_defconfig
```kconfig
#### BCM WLAN CONFIG ####
#
# MSM Board Selection
#
CONFIG_WIFI_CONTROL_FUNC=y
# CONFIG_WIFI_MEM_PREALLOC is not set
# CONFIG_MSM_WCNSS_SSR_8960 is not set
#
# Wireless device drivers
#
# CONFIG_AF_RXRPC is not set
CONFIG_FIB_RULES=y
CONFIG_WIRELESS=y
CONFIG_WIRELESS_EXT=y
CONFIG_WEXT_CORE=y
CONFIG_WEXT_PROC=y
# CONFIG_WEXT_SPY is not set
CONFIG_WEXT_PRIV=y
CONFIG_CFG80211=y
CONFIG_NL80211_TESTMODE=y
# CONFIG_CFG80211_DEVELOPER_WARNINGS is not set
# CONFIG_CFG80211_REG_DEBUG is not set
CONFIG_CFG80211_DEFAULT_PS=y
# CONFIG_CFG80211_DEBUGFS is not set
# CONFIG_CFG80211_INTERNAL_REGDB is not set
# CONFIG_CFG80211_WEXT is not set
# CONFIG_WIRELESS_EXT_SYSFS is not set
# CONFIG_LIB80211 is not set
CONFIG_CFG80211_ALLOW_RECONNECT=y
#
# SCSI Transports
#
CONFIG_NETDEVICES=y
CONFIG_IFB=y
# CONFIG_DUMMY is not set
# CONFIG_BONDING is not set
# CONFIG_MACVLAN is not set
# CONFIG_EQUALIZER is not set
CONFIG_TUN=y
# CONFIG_VETH is not set
CONFIG_MII=y
CONFIG_PHYLIB=y
#
# MII PHY device drivers
#
CONFIG_NETDEV_1000=y
# CONFIG_STMMAC_ETH is not set
# CONFIG_QFEC is not set
CONFIG_NETDEV_10000=y
CONFIG_WLAN=y
CONFIG_USB_ZD1201=y
# CONFIG_USB_NET_RNDIS_WLAN is not set
# CONFIG_LIBRA_SDIOIF is not set
# CONFIG_WCNSS_CORE is not set
# CONFIG_ATH_COMMON is not set
# CONFIG_BCM4329 is not set
CONFIG_BCMDHD=y
CONFIG_BCMDHD_FW_PATH="/vendor/firmware/fw_bcmdhd.bin"
CONFIG_BCMDHD_NVRAM_PATH="/vendor/firmware/nvram.txt"
# CONFIG_HOSTAP is not set
# CONFIG_IWM is not set
# CONFIG_LIBERTAS is not set
# CONFIG_MWIFIEX is not set
#
# MMC/SD/SDIO Host Controller Drivers
#
CONFIG_MMC_MSM_SDC4_SUPPORT=y
# CONFIG_MMC_MSM_SDC4_8_BIT_SUPPORT is not set
#
# Library routines
#
CONFIG_AVERAGE=y


#### BCM BT CONFIG ####

#
# Bluetooth device drivers
#
CONFIG_BT=y
CONFIG_BT_L2CAP=y
CONFIG_BT_SCO=y
CONFIG_BT_RFCOMM=y
CONFIG_BT_RFCOMM_TTY=y
CONFIG_BT_BNEP=y
CONFIG_BT_BNEP_MC_FILTER=y
CONFIG_BT_BNEP_PROTO_FILTER=y
CONFIG_BT_HIDP=y

# CONFIG_BT_HCISMD is not set
# CONFIG_BT_HCIBTUSB is not set
# CONFIG_BT_HCIBTSDIO is not set
CONFIG_BT_HCIUART=y
CONFIG_BT_HCIUART_H4=y
# CONFIG_BT_HCIUART_BCSP is not set
# CONFIG_BT_HCIUART_ATH3K is not set
# CONFIG_BT_HCIUART_LL is not set
# CONFIG_BT_HCIUART_IBS is not set
# CONFIG_BT_HCIBCM203X is not set
# CONFIG_BT_HCIBPA10X is not set
CONFIG_BT_MSM_SLEEP=y
# CONFIG_BT_HCIBFUSB is not set
# CONFIG_BT_HCIVHCI is not set
# CONFIG_BT_MRVL is not set
CONFIG_MSM_BT_POWER=y
# CONFIG_MAC80211 is not set
# CONFIG_WIMAX is not set
CONFIG_RFKILL=y
CONFIG_RFKILL_PM=y
CONFIG_RFKILL_LEDS=y
# CONFIG_RFKILL_INPUT is not set
# CONFIG_RFKILL_REGULATOR is not set
# CONFIG_RFKILL_GPIO is not set
# CONFIG_NET_9P is not set
# CONFIG_CAIF is not set
# CONFIG_CEPH_LIB is not set


#
# Non-8250 serial port support
#
# CONFIG_SERIAL_BCM_BT_LPM is not set
CONFIG_BCM_BT=y
#


#
# HID
##
CONFIG_HID_SUPPORT=y
CONFIG_HID=y
# CONFIG_HIDRAW is not set
```

## arch/arm/configs/hw_msm8960_wcn_defconfig
```kconfig
#### WCN WLAN CONFIG ####
#
# MSM Board Selection
#
# CONFIG_WIFI_CONTROL_FUNC is not set
# CONFIG_WIFI_MEM_PREALLOC is not set
CONFIG_MSM_WCNSS_SSR_8960=y
#
# Wireless device drivers
#
# CONFIG_AF_RXRPC is not set
CONFIG_FIB_RULES=y
CONFIG_WIRELESS=y
CONFIG_WIRELESS_EXT=y
CONFIG_WEXT_CORE=y
CONFIG_WEXT_PROC=y
CONFIG_WEXT_SPY=y
CONFIG_WEXT_PRIV=y
CONFIG_CFG80211=y
# CONFIG_NL80211_TESTMODE is not set
# CONFIG_CFG80211_DEVELOPER_WARNINGS is not set
# CONFIG_CFG80211_REG_DEBUG is not set
CONFIG_CFG80211_DEFAULT_PS=y
# CONFIG_CFG80211_DEBUGFS is not set
# CONFIG_CFG80211_INTERNAL_REGDB is not set
# CONFIG_CFG80211_WEXT is not set
CONFIG_WIRELESS_EXT_SYSFS=y
# CONFIG_LIB80211 is not set
# CONFIG_CFG80211_ALLOW_RECONNECT is not set
#
# SCSI Transports
#
CONFIG_NETDEVICES=y
# CONFIG_IFB is not set
CONFIG_DUMMY=y
# CONFIG_BONDING is not set
# CONFIG_MACVLAN is not set
# CONFIG_EQUALIZER is not set
CONFIG_TUN=y
# CONFIG_VETH is not set
CONFIG_MII=y
CONFIG_PHYLIB=y
#
# MII PHY device drivers
#
# CONFIG_NETDEV_1000 is not set
# CONFIG_STMMAC_ETH is not set
# CONFIG_QFEC is not set
# CONFIG_NETDEV_10000 is not set
CONFIG_WLAN=y
# CONFIG_USB_ZD1201 is not set
# CONFIG_USB_NET_RNDIS_WLAN is not set
# CONFIG_LIBRA_SDIOIF is not set
CONFIG_WCNSS_CORE=y
# CONFIG_ATH_COMMON is not set
# CONFIG_BCM4329 is not set
# CONFIG_BCMDHD is not set
# CONFIG_BCMDHD_FW_PATH is not set
# CONFIG_BCMDHD_NVRAM_PATH is not set
# CONFIG_HOSTAP is not set
# CONFIG_IWM is not set
# CONFIG_LIBERTAS is not set
# CONFIG_MWIFIEX is not set
#
# MMC/SD/SDIO Host Controller Drivers
#
# CONFIG_MMC_MSM_SDC4_SUPPORT is not set
# CONFIG_MMC_MSM_SDC4_8_BIT_SUPPORT is not set
#
# Library routines
#
# CONFIG_AVERAGE is not set


#### WCN BT CONFIG ####

CONFIG_BT_WCN = y

#
# Bluetooth device drivers
#
CONFIG_BT=y
CONFIG_BT_L2CAP=y
CONFIG_BT_SCO=y
CONFIG_BT_RFCOMM=y
CONFIG_BT_RFCOMM_TTY=y
CONFIG_BT_BNEP=y
CONFIG_BT_BNEP_MC_FILTER=y
CONFIG_BT_BNEP_PROTO_FILTER=y
CONFIG_BT_HIDP=y

CONFIG_BT_HCISMD=y
# CONFIG_MAC80211 is not set
# CONFIG_WIMAX is not set
CONFIG_RFKILL=y
CONFIG_RFKILL_PM=y
CONFIG_RFKILL_LEDS=y
# CONFIG_RFKILL_INPUT is not set
# CONFIG_RFKILL_REGULATOR is not set
# CONFIG_RFKILL_GPIO is not set
# CONFIG_NET_9P is not set
# CONFIG_CAIF is not set
# CONFIG_CEPH_LIB is not set


#
# Non-8250 serial port support
#
# CONFIG_SERIAL_BCM_BT_LPM is not set


#
# HID
##
CONFIG_HID_SUPPORT=y
CONFIG_HID=y
# CONFIG_HIDRAW is not set

#
# Non-8250 serial port support
#
CONFIG_WCN_BT=y
#
```

## drivers/huawei/Kconfig
```kconfig
menu "huawei linux device driver support package"

source "drivers/huawei/device/Kconfig"

#ifdef CONFIG_HUAWEI_GPIO_UNITE
source "drivers/huawei/gpio/Kconfig"
#endif

#ifdef CONFIG_HW_POWER_TREE
source "drivers/huawei/power_config/Kconfig"
#endif

#ifdef CONFIG_HUAWEI_SUSPEND_GPIO
source "drivers/huawei/gpio/Kconfig"
#endif

endmenu
```

## drivers/huawei/device/Kconfig
```kconfig
menu "huawei linux device driver support package"

source "drivers/huawei/device/accelerometer/Kconfig"

source "drivers/huawei/device/compass/Kconfig"

source "drivers/huawei/device/light/Kconfig"

source "drivers/huawei/device/gyroscope/Kconfig"

source "drivers/huawei/device/touchscreen/Kconfig"

source "drivers/huawei/device/touchkey/Kconfig"

source "drivers/huawei/device/gauge/Kconfig"
source "drivers/huawei/device/usbswitch/Kconfig"

source "drivers/huawei/device/ak6921af/Kconfig"

endmenu
```

## drivers/huawei/device/accelerometer/Kconfig
```kconfig
#
# accelerometer driver configuration
#
menuconfig INPUT_ACCELEROMETER
	bool "Accelerometer"
	help
	  Say Y here, and a list of supported ACCELEROMETERs will be displayed.
	  This option doesn't affect the kernel.

	 

if INPUT_ACCELEROMETER


config HUAWEI_FEATURE_SENSORS_ACCELEROMETER_MMA8452
	tristate "FREESCALE MMA8452 accelerometer"
	select SERIO
	help
	  Say Y here if you have the FREESCALE MMA8452 accelerometer.


config HUAWEI_FEATURE_SENSORS_ACCELEROMETER_ADI_ADXL346
	tristate "ADI ADXL346 accelerometer"
	select SERIO
	help
	  Say Y here if you have the ADI ADXL346 accelerometer.


config HUAWEI_FEATURE_SENSORS_ACCELEROMETER_ST_LIS3XH
	tristate "ST LIS3DH and LIS331DLH accelerometer"	
	select SERIO
	help
	  Say Y here if you have the ST LIS3DH and LIS331DLH accelerometer.
endif
```

## drivers/huawei/device/ak6921af/Kconfig
```kconfig
#
# Near Field Communication (NFC) devices
#

menuconfig HUAWEI_KERNEL_FELICA_DEVICES
	bool "Near Field Communication (NFC) devices"
	default n
	---help---
	  You'll have to say Y if your computer contains an NFC device that
	  you want to use under Linux.

	  You can say N here if you don't have any Near Field Communication
	  devices connected to your computer.

if HUAWEI_KERNEL_FELICA_DEVICES

config HUAWEI_FEATURE_FELICA_T6ND5
	tristate "T6ND5 FELICA driver"
	default n
	---help---
	  Say yes if you want T6ND5 Near Field Communication driver.
	  This is for i2c connected version. If unsure, say N here.

	  To compile this driver as a module, choose m here. The module will
	  be called t6nd5.


endif # HUAWEI_KERNEL_FELICA_DEVICES
```

## drivers/huawei/device/compass/Kconfig
```kconfig
#
# compass driver configuration
#
menuconfig INPUT_COMPASS
	bool "Compass"
	help
	  Say Y here, and a list of supported COMPASSs will be displayed.
	  This option doesn't affect the kernel.

	 

if INPUT_COMPASS

config HUAWEI_FEATURE_SENSORS_AK8975
	tristate "AK8975"
	depends on I2C
	help
	  If you say yes here you get support for Asahi Kasei's 
	  orientation sensor AK8975.

config HUAWEI_FEATURE_SENSORS_AK8963
	tristate "AK8963 compass support"
	depends on I2C
	help
	  If you say yes here you get support for Asahi Kasei's
	  orientation sensor AK8963.

config HUAWEI_FEATURE_SENSORS_YAMAHA_COMPASS
	tristate "Yamaha compass support"
	depends on I2C
	help
	  If you say yes here you get support for Asahi Kasei's
	  orientation sensor AK8963.
endif
```

## drivers/huawei/device/gauge/Kconfig
```kconfig
#
# fuel gauge driver configuration
#
menuconfig INPUT_FUEL_GAUGE
	bool "fuel gauge"
	default y
	help
	  Say Y here, and a list of supported fuel gauge will be displayed.
	  This option doesn't affect the kernel.

	 

if INPUT_FUEL_GAUGE

config BATTERY_BQ275x0
	tristate "bq27510 fule gauge driver"
  depends on I2C
	default y 
	help
	  Say Y here if you have the bq27510 fuel gauge.
	  
endif
```

## drivers/huawei/device/gyroscope/Kconfig
```kconfig
#
# gyroscope driver configuration
#
menuconfig INPUT_GYROSCOPE
	bool "gyroscope"
	help
	  Say Y here, and a list of supported gyroscopes will be displayed.
	  This option doesn't affect the kernel.

	 

if INPUT_GYROSCOPE

config HUAWEI_FEATURE_GYROSCOPE_L3G4200DH
	tristate "L3G4200DH"
	default y 
	help
	  Say Y here if you have the ST L3G4200DH gyroscope.
	  
endif
```

## drivers/huawei/device/light/Kconfig
```kconfig
#
# light sensor driver configuration
#
menuconfig INPUT_LIGHT_SENSOR
	bool "light sensor"
	help
	  Say Y here, and a list of supported light sensors will be displayed.
	  This option doesn't affect the kernel.

	 

if INPUT_LIGHT_SENSOR
#config HUAWEI_FEATURE_PROXIMITY_EVERLIGHT_TMD2771
#	tristate "tmd2771"
#	default y
#	help
#	  If you say yes here you get support for taos light sensor tmd2771.
config HUAWEI_FEATURE_PROXIMITY_APDS990X
	tristate "apds990x"
	default y
	help
	  If you say yes here you get support for light sensor apds990x.

endif
```

## drivers/huawei/device/touchkey/Kconfig
```kconfig
#
# Input core configuration
#
menuconfig HUAWEI_FEATURE_INPUT_TOUCHKEY
	bool "Touchkeys"
	default y
	help
	  Say Y here, and a list of supported touchkeys will be displayed.
	  This option doesn't affect the kernel.

	  If unsure, say Y.

if HUAWEI_FEATURE_INPUT_TOUCHKEY

config HUAWEI_FEATURE_TOUCHKEY_ATMEL
	tristate "Atmel touch keypad support"
	default n
	help
	  Say Y here if you want to use the Atmel touch keypad.

	  To compile this driver as a module, choose M here: the
	  module will be called Atmel-touchkey.

config HUAWEI_FEATURE_TOUCHKEY_BL
	tristate "Atmel touch key backlight support"
	default y
	help
	  Say Y here if you want to use the Atmel touch keypad.

	  To compile this driver as a module, choose M here: the
	  module will be called Touchkey-backlight.
endif
```

## drivers/huawei/device/touchscreen/Kconfig
```kconfig
#
# Touchscreen driver configuration
#
menuconfig INPUT_TOUCHSCREEN
	bool "Touchscreens"
	help
	  Say Y here, and a list of supported touchscreens will be displayed.
	  This option doesn't affect the kernel.

	  If unsure, say Y.

if INPUT_TOUCHSCREEN

config TOUCHSCREEN_MXT224E_ATMEL
        default n
	tristate "Atmel mXT224E touchscreens"
	depends on I2C
	help
          Say Y here to enable support Atmel mXT224E
config  TOUCHSCREEN_RMI4_SYNAPTICS
        default n
	tristate "synaptics_i2c_rmi_1564"
	depends on I2C
	help
          Say Y here to enable support synaptics_i2c_rmi_1564
config  SYNAPTICS_UPDATE_RMI_TS_FIRMWARE
        default n	
	bool "SYNAPTICS Touchscreen firmware update"
	help
          Say Y here to enable support synaptics_i2c_rmi_1564
endif
```

## drivers/huawei/device/usbswitch/Kconfig
```kconfig
#
# usbswitch device configuration
#

menu "usbswitch support"

config HUAWEI_USBSWITCH
	tristate "HUAWEI_USBSWITCH"
	default y
	help

endmenu
```

## drivers/huawei/gpio/Kconfig
```kconfig
#
# GPIO configuration
#
menuconfig HUAWEI_GPIO
	bool "huawei gpio"
	help
	  Say Y here, and a list of supported gpio config will be displayed.
	  This option doesn't affect the kernel.

	  If unsure, say Y.

if HUAWEI_GPIO

config  HUAWEI_GPIO_UNITE
        default y
	bool "huawei gpio unite"
	help
          Say Y here to enable support gpio_config

config  HUAWEI_SUSPEND_GPIO
        default n
	bool "huawei suspend gpio config"
	help
          Say Y here to enable support suspend gpio config
endif
```

## drivers/huawei/power_config/Kconfig
```kconfig
#================================================================================
#================================================================================
menuconfig HW_POWER
	bool "config_hw_power"
	default y
	help
	  Say Y here, and a list of supported regulators config will be displayed.
	  This option doesn't affect the kernel.

	  If unsure, say Y.

if HW_POWER

config  HW_POWER_TREE
	bool "config_hw_power_tree"
	default y
	help
          Say Y here to enable support config_hw_power
   
endif
```

## drivers/video/mm_tuner/Kconfig
```kconfig
#
# MM_TUNER subsystem configuration
#
source drivers/video/mm_tuner/src/Kconfig
```

## drivers/video/mm_tuner/src/Kconfig
```kconfig
#
# MM_TUNER subsystem configuration
#

menuconfig MM_TUNER
	tristate "MM_TUNRER support"
	---help---
	  MM_TUNRER.



config MMTUNER
	boolean
	default y

config ISDBTUNER
    bool "isdb tuner support"
	help
	  Choose this option if you want to use isdb tuner.
	
	default n
```
